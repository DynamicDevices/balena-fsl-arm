## layers/meta-balena-fsl-arm/conf/machine/jaguar-edge-ai-imx8mm.conf
```bitbake
#@TYPE: Machine
#@NAME: Active Edge Jaguar AI i.MX8MM 
#@SOC: i.MX8 MM
#@DESCRIPTION: Machine configuration for Active Edge Solutions Ltd Jaguar AI i.MX8MM

MACHINEOVERRIDES = "imx8mm-lpddr4-evk:${MACHINE}"

include conf/machine/imx8mm-lpddr4-evk.conf
```
